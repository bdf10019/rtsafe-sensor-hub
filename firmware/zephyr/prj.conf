## CMakeLists.txt
```
cmake_minimum_required(VERSION 3.20.0)

find_package(Zephyr REQUIRED HINTS $ENV{ZEPHYR_BASE})
project(rtsafe_firmware)

target_include_directories(app PRIVATE
    include
    ../../include
)

target_sources(app PRIVATE
    src/main.c
    src/board_io_sim.c
    ../../src/core/crc16.c
    ../../src/core/filters.c
    ../../src/core/pipeline.c
    ../../src/core/protocol.c
    ../../src/core/safety.c
)
```

## sample.yaml
```
sample:
  name: Deterministic Sensor and Safety Hub
  description: Multi-threaded sensor, safety, and telemetry pipeline
tests:
  sample.rtsafe.sensor_hub:
    platform_allow:
      - qemu_cortex_m3
    tags:
      - rtos
      - safety
      - telemetry
    harness: console
    harness_config:
      type: one_line
      regex:
        - "RTSAFE_READY"
```

## prj.conf
```kconfig
CONFIG_PRINTK=y
CONFIG_ASSERT=y
CONFIG_PICOLIBC=y
CONFIG_MAIN_STACK_SIZE=2048
CONFIG_SYSTEM_WORKQUEUE_STACK_SIZE=1024
CONFIG_CBPRINTF_FP_SUPPORT=n
```

## src/main.c
```c
#include "board_io.h"
#include "rtsafe/pipeline.h"
#include "rtsafe/protocol.h"

#include <zephyr/kernel.h>
#include <zephyr/sys/printk.h>

#include <stdint.h>

#define SENSOR_STACK_SIZE 1536
#define CONTROL_STACK_SIZE 2048
#define TELEMETRY_STACK_SIZE 1536

K_MSGQ_DEFINE(sensor_queue, sizeof(rtsafe_input_t), 16, 4);
K_MSGQ_DEFINE(status_queue, sizeof(rtsafe_status_t), 16, 4);

static rtsafe_pipeline_t pipeline;
static uint32_t previous_execution_us;

static void sensor_thread(void *first, void *second, void *third)
{
    ARG_UNUSED(first);
    ARG_UNUSED(second);
    ARG_UNUSED(third);

    while (true) {
        rtsafe_input_t input;
        if (rtsafe_board_read_sensors(&input)) {
            if (k_msgq_put(&sensor_queue, &input, K_NO_WAIT) != 0) {
                printk("sensor_queue_overflow\n");
            }
        }
        k_sleep(K_USEC(1000));
    }
}

static void control_thread(void *first, void *second, void *third)
{
    ARG_UNUSED(first);
    ARG_UNUSED(second);
    ARG_UNUSED(third);

    while (true) {
        rtsafe_input_t input;
        if (k_msgq_get(&sensor_queue, &input, K_FOREVER) == 0) {
            const uint32_t started = k_cycle_get_32();
            rtsafe_status_t status = rtsafe_pipeline_step(
                &pipeline,
                &input,
                input.timestamp_us,
                previous_execution_us
            );
            rtsafe_board_apply_output(&status);
            if (k_msgq_put(&status_queue, &status, K_NO_WAIT) != 0) {
                printk("status_queue_overflow\n");
            }
            previous_execution_us = (uint32_t)k_cyc_to_us_floor64(
                (uint64_t)(k_cycle_get_32() - started)
            );
        }
    }
}

static void telemetry_thread(void *first, void *second, void *third)
{
    ARG_UNUSED(first);
    ARG_UNUSED(second);
    ARG_UNUSED(third);

    while (true) {
        rtsafe_status_t status;
        uint8_t frame[RTSAFE_TELEMETRY_FRAME_SIZE];
        if (k_msgq_get(&status_queue, &status, K_FOREVER) == 0 &&
            rtsafe_encode_telemetry(&status, frame, sizeof(frame))) {
            rtsafe_board_publish_frame(frame, sizeof(frame), status.sequence);
        }
    }
}

K_THREAD_DEFINE(
    sensor_thread_id,
    SENSOR_STACK_SIZE,
    sensor_thread,
    NULL,
    NULL,
    NULL,
    2,
    0,
    20
);
K_THREAD_DEFINE(
    control_thread_id,
    CONTROL_STACK_SIZE,
    control_thread,
    NULL,
    NULL,
    NULL,
    1,
    0,
    20
);
K_THREAD_DEFINE(
    telemetry_thread_id,
    TELEMETRY_STACK_SIZE,
    telemetry_thread,
    NULL,
    NULL,
    NULL,
    5,
    0,
    20
);

int main(void)
{
    const rtsafe_config_t config = rtsafe_default_config();
    if (!rtsafe_pipeline_init(&pipeline, &config)) {
        printk("RTSAFE_INIT_FAILED\n");
        return 1;
    }

    printk("RTSAFE_READY sample_period_us=%u budget_us=%u\n",
        config.sample_period_us,
        config.execution_budget_us);
    return 0;
}
```

## include/board_io.h
```c
#ifndef RTSAFE_BOARD_IO_H
#define RTSAFE_BOARD_IO_H

#include "rtsafe/types.h"

#include <stdbool.h>
#include <stddef.h>
#include <stdint.h>

bool rtsafe_board_read_sensors(rtsafe_input_t *input);
void rtsafe_board_apply_output(const rtsafe_status_t *status);
void rtsafe_board_publish_frame(const uint8_t *frame, size_t size, uint32_t sequence);

#endif
```

## src/board_io_sim.c
```c
#include "board_io.h"

#include <zephyr/kernel.h>
#include <zephyr/sys/printk.h>

#include <string.h>

bool rtsafe_board_read_sensors(rtsafe_input_t *input)
{
    static int32_t encoder_ticks;
    static uint32_t sample_count;
    static uint64_t last_heartbeat_us;
    const uint64_t now_us = (uint64_t)k_uptime_get() * 1000U;
    int32_t phase;

    if (input == NULL) {
        return false;
    }

    memset(input, 0, sizeof(*input));
    encoder_ticks += 2;
    phase = (int32_t)(sample_count % 200U) - 100;
    if (sample_count % 20U == 0U) {
        last_heartbeat_us = now_us;
    }

    input->timestamp_us = now_us;
    input->heartbeat_timestamp_us = last_heartbeat_us;
    input->acceleration_mps2[0] = (float)phase * 0.01F;
    input->acceleration_mps2[2] = 9.81F;
    input->angular_rate_rps[2] = (float)phase * 0.001F;
    input->encoder_ticks = encoder_ticks;
    input->force_n = 10.0F;
    input->imu_valid = true;
    input->encoder_valid = true;
    input->force_valid = true;
    ++sample_count;
    return true;
}

void rtsafe_board_apply_output(const rtsafe_status_t *status)
{
    ARG_UNUSED(status);
    /* A real board port maps motor_enabled and pwm_limit to a fail-safe output. */
}

void rtsafe_board_publish_frame(const uint8_t *frame, size_t size, uint32_t sequence)
{
    ARG_UNUSED(frame);
    ARG_UNUSED(size);
    if (sequence % 250U == 0U) {
        printk("telemetry sequence=%u\n", sequence);
    }
}
```
