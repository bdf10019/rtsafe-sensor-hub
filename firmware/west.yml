## firmware/west.yml
```yaml
manifest:
  version: "1.2"

  remotes:
    - name: upstream
      url-base: https://github.com/zephyrproject-rtos

  projects:
    - name: zephyr
      remote: upstream
      revision: v4.4.0
      path: zephyr
      import:
        path-prefix: .deps
        name-allowlist:
          - cmsis
          - cmsis_6
          - hal_ti

  self:
    path: firmware
```

## firmware/zephyr/tests/core/testcase.yaml
```yaml
tests:
  rtsafe.core:
    platform_allow:
      - qemu_cortex_m3
    tags:
      - rtsafe
      - unit
```

## tools/zephyr-stage-manifest/west.yml
```yaml
manifest:
  version: "1.2"

  remotes:
    - name: upstream
      url-base: https://github.com/zephyrproject-rtos

  projects:
    - name: zephyr
      remote: upstream
      revision: v4.4.0
      path: .deps/zephyr
      west-commands: scripts/west-commands.yml
    - name: cmsis
      remote: upstream
      revision: 512cc7e895e8491696b61f7ba8066b4a182569b8
      path: .deps/modules/hal/cmsis
    - name: cmsis_6
      remote: upstream
      repo-path: CMSIS_6
      revision: 30a859f44ef8ab4dc8f84b03ed586fd16ccf9d74
      path: .deps/modules/hal/cmsis_6
    - name: hal_ti
      remote: upstream
      revision: afbcfffd393be03ca2c9b41f9ce8d94a4c2f2fbd
      path: .deps/modules/hal/ti

  self:
    path: manifest
```

## yocto/meta-rtsafe/conf/layer.conf
```bitbake
BBPATH .= ":${LAYERDIR}"
BBFILES += "${LAYERDIR}/recipes-*/*/*.bb ${LAYERDIR}/recipes-*/*/*.bbappend"

BBFILE_COLLECTIONS += "rtsafe"
BBFILE_PATTERN_rtsafe = "^${LAYERDIR}/"
BBFILE_PRIORITY_rtsafe = "7"

LAYERSERIES_COMPAT_rtsafe = "scarthgap"
```
